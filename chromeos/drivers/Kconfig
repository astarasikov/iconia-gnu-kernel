## chromeos/drivers/Kconfig
```kconfig
menu "Chromeos Supplied Third-Party Device Drivers"

source "chromeos/drivers/gobi/Kconfig"

endmenu
```

## chromeos/drivers/gobi/Kconfig
```kconfig
config GOBI_USBNET
	tristate "Qualcomm GOBI2k and QCQMI support using Code Aurora driver"
	help
	This module adds network device support for GOBI2k 3G radios.

config GOBI_QCSERIAL
	tristate "Qualcomm GOBI2k serial support using Code Aurora driver"
	help
	This module adds serial port support for GOBI2k 3G radios.
```

## drivers/md/persistent-data/Kconfig
```kconfig
config DM_PERSISTENT_DATA
       tristate "Persistent data library (EXPERIMENTAL)"
       depends on BLK_DEV_DM && EXPERIMENTAL
       select LIBCRC32C
       ---help---
	 Library providing immutable on-disk data structure support for
	 device-mapper targets such as the thin provisioning target.
```

## drivers/media/video/tegra/Kconfig
```kconfig
source "drivers/media/video/tegra/avp/Kconfig"

config TEGRA_CAMERA
        bool "Enable support for tegra camera/isp hardware"
        depends on ARCH_TEGRA
        default y
        help
          Enables support for the Tegra camera interface

          If unsure, say Y

config TEGRA_MEDIASERVER
	bool "Tegra Media Server support"
	depends on ARCH_TEGRA && TEGRA_RPC && TEGRA_NVMAP && TEGRA_AVP
	help
	  Enables support for the multiple OpenMAX clients.  Exports the
	  interface on the device node /dev/tegra_mediaserver.

	  If unsure, say Y
```

## drivers/staging/asusec/Kconfig
```kconfig
config ASUSEC
       tristate "ASUS embedded controller"
       depends on I2C && EXPERIMENTAL
       default N
       help
            KB, battery and dock station controller for asus tf101
```

## sound/soc/tegra/Kconfig
```kconfig
config SND_TEGRA_SOC
	tristate "SoC Audio for the Tegra System-on-Chip"
	depends on ARCH_TEGRA && TEGRA_SYSTEM_DMA
	default m
	help
	  Say Y or M here if you want support for SoC audio on Tegra.

config SND_TEGRA_SOC_I2S
	tristate
	depends on SND_TEGRA_SOC
	default m
	help
	  Say Y or M if you want to add support for codecs attached to the
	  Tegra I2S interface. You will also need to select the individual
	  machine drivers to support below.

config SND_TEGRA_SOC_SPDIF
	tristate
	depends on SND_TEGRA_SOC
	default m
	help
	  Say Y or M if you want to add support for the SPDIF interface.
	  You will also need to select the individual machine drivers to support
	  below.

config SND_TEGRA_SOC_HARMONY
	tristate "SoC Audio support for Tegra Harmony reference board"
	depends on SND_TEGRA_SOC && MACH_HARMONY && I2C
	default m
	select SND_TEGRA_SOC_I2S
	select SND_SOC_WM8903
	help
	  Say Y or M here if you want to add support for SoC audio on the
	  Tegra Harmony reference board.

config SND_TEGRA_SOC_SEABOARD
	tristate "SoC Audio support for Tegra Seaboard reference board"
	depends on SND_TEGRA_SOC && I2C
	depends on MACH_SEABOARD
	default m
	select SND_TEGRA_SOC_I2S
	select SND_TEGRA_SOC_SPDIF
	select SND_SOC_MAX98095
	select SND_SOC_WM8903
	select SND_SOC_SPDIF
	help
	  Say Y or M here if you want to add support for SoC audio on the
	  Tegra Seaboard reference board, or its derivatives Kaen and Aebl.
```
